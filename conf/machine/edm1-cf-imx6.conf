## conf/machine/edm1-cf-imx6.conf
```bitbake
#@TYPE: Machine
#@NAME: edm1-cf-imx6 
#@DESCRIPTION: Machine configuration for the Technexion edm1-cf-imx6 

SOC_FAMILY = "mx6:mx6dl:mx6q"
TARGET_ARCH = "arm"

DEFAULTTUNE ?= "cortexa9hf-neon"

include conf/machine/include/imx-base.inc
include conf/machine/include/tune-cortexa9.inc

#PREFERRED_PROVIDER_virtual/kernel = "linux-stable"
PREFERRED_PROVIDER_virtual/kernel = "linux-tn-imx"
KERNEL_IMAGETYPE = "zImage"

# PREFERRED_PROVIDER_virtual/bootloader = "u-boot-edm"
# PREFERRED_PROVIDER_u-boot = "u-boot-edm"

PREFERRED_PROVIDER_virtual/bootloader = "u-boot"
PREFERRED_PROVIDER_u-boot = "u-boot"

UBOOT_MACHINE = "edm-cf-imx6_config"
BOOTENV_SIZE = "0x20000"

EXTRA_IMAGEDEPENDS += "u-boot"

SERIAL_CONSOLE = "115200 ttymxc0"

IMAGE_FSTYPES = "tar.xz"

MACHINE_FEATURES = "ext2 serial usbhost vfat"
```
